## samples/sensor/bmi160/sample.yaml
```yaml
sample:
  name: BMI160 Sensor Sample
tests:
  test:
    harness: sensor
    platform_whitelist: arduino_101_sss nrf52_pca10040
    tags: sensors
    depends_on: spi gpio
```
